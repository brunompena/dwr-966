## kernel/arch/mips/lantiq/Kconfig
```kconfig
if LANTIQ

config SOC_TYPE_XWAY
	bool
	select PINCTRL_XWAY
	select USB_ARCH_HAS_HCD
	default n

choice
	prompt "SoC Type"
	default SOC_XWAY

config SOC_AMAZON_SE
	bool "Amazon SE"
	select SOC_TYPE_XWAY

config SOC_XWAY
	bool "XWAY"
	select SOC_TYPE_XWAY
	select HW_HAS_PCI
	select ARCH_SUPPORTS_MSI

config SOC_FALCON
	bool "FALCON"
	select PINCTRL_FALCON

endchoice

choice
	prompt "Devicetree"

config DT_EASY50712
	bool "Easy50712"
	depends on SOC_XWAY
endchoice

config PCI_LANTIQ_BOOT
	bool "PCI Boot Support"
	depends on SOC_XWAY && PCI && !PCI_LANTIQ
	default n
	---help---
	PCI bonding boot used for DSL off-chip bonding. Only xRX200 platform is
	supported To use this option, xRX200 family board and bonding daughter
	board must connect each other.

config PCI_LANTIQ
	bool "PCI Support"
	depends on SOC_XWAY && PCI

config PCIE_LANTIQ
	bool "PCIE Support"
	depends on SOC_XWAY && PCI
choice
	prompt "LANTIQ PCIE: Default PCIe PHY Clock Mode"
	depends on PCIE_LANTIQ
	default LANTIQ_PCIE_PHY_36MHZ_MODE
	---help---
	  Select ifx pci express phy clock mode by default.
	config LANTIQ_PCIE_PHY_36MHZ_MODE
	    bool "36MHz"

	config LANTIQ_PCIE_PHY_36MHZ_SSC_MODE
	    bool "36MHz SSC mode"

	config LANTIQ_PCIE_PHY_25MHZ_MODE
	    bool "25MHz"

	config LANTIQ_PCIE_PHY_100MHZ_MODE
	    bool "100MHz"
endchoice

config LANTIQ_PCIE_1ST_CORE
	bool "Lantiq PCIE Core 0 Support"
	depends on PCIE_LANTIQ
	default y

config LANTIQ_PCIE_HW_SWAP
	bool "Lantiq PCIE Core 0 Outbound Hardware Swap Support"
	depends on LANTIQ_PCIE_1ST_CORE
	default y
	---help---
	  This will enable PCIe Core 0 Outbound hardware swap. It should be
	  enabled together with PCI

config LANTIQ_PCIE_INBOUND_NO_HW_SWAP
	bool "Lantiq PCIE Core 0 Inbound Hardware Swap disabled"
	depends on LANTIQ_PCIE_1ST_CORE
	default n
	---help---
	  This will disable PCIe Core 0 Inbound Hardware Swap. It should be
	  only used together with VRX318

config LANTIQ_PCIE_RST_EP_ACTIVE_HIGH
	bool "Lantiq PCIE Core 0 EP reset signal active high"
	depends on LANTIQ_PCIE_1ST_CORE
	default n
	---help---
	  Normally PCIe EP reset is low active. It should be only used
	  together with VRX318 due to dying gasp

config LANTIQ_PCIE_2ND_CORE
	bool "Lantiq PCIE Core 1 Support"
	depends on PCIE_LANTIQ
	default n
	---help---
	  This will enable 2nd PCIe RC support

config LANTIQ_PCIE1_HW_SWAP
	bool "Lantiq PCIE Core 1 Outbound Hardware Swap Support"
	depends on LANTIQ_PCIE_2ND_CORE
	default n
	---help---
	  This will enable PCIe Core 1 Outbound data swap. It should be
	  enabled together with PCI

config LANTIQ_PCIE1_INBOUND_NO_HW_SWAP
	bool "Lantiq PCIE Core 1 Inbound Hardware Swap Disabled"
	depends on LANTIQ_PCIE_2ND_CORE
	default n
	---help---
	  This will disable PCIe Core 1 Inbound Hardware Swap. It should be
	  only used together with VRX318

config LANTIQ_PCIE1_RST_EP_ACTIVE_HIGH
	bool "Lantiq PCIE Core 1 EP reset signal active high"
	depends on LANTIQ_PCIE_2ND_CORE
	default n
	---help---
	  Normally PCIe EP reset is low active. It should be only used together
	  with VRX318 due to dyning gasp

config LANTIQ_PCIE_3RD_CORE
	bool "Lantiq PCIE Core 2 Support"
	depends on PCIE_LANTIQ
	default n
	---help---
	  This will enable 3rd PCIe RC support

config LANTIQ_PCIE2_HW_SWAP
	bool "Lantiq PCIE Core 2 Outbound Hardware Swap Support"
	depends on LANTIQ_PCIE_3RD_CORE
	default n
	---help---
	  This will enable PCIe Core 2 Outbound data swap. It should be enabled
	  together with PCI

config LANTIQ_PCIE2_INBOUND_NO_HW_SWAP
	bool "Lantiq PCIE Core 2 Inbound Hardware Swap Disabled"
	depends on LANTIQ_PCIE_3RD_CORE
	default n
	---help---
	  This will disable PCIe Core 2 Inbound Hardware Swap. It should be
	  only used together with VRX318

config LANTIQ_PCIE2_RST_EP_ACTIVE_HIGH
	bool "Lantiq PCIE Core 2 EP reset signal active high"
	depends on LANTIQ_PCIE_3RD_CORE
	default n
	---help---
	  Normally PCIe EP reset is low active. It should be only used together
	  with VRX318 due to dyning gasp

config PCIE_LANTIQ_MSI
	bool
	depends on PCIE_LANTIQ && PCI_MSI
	default y

config XRX200_PHY_FW
	bool "XRX200 PHY firmware loader"
	depends on SOC_XWAY

config LANTIQ_IMAGE_EXTRA_CHECKS
	bool "Extra check fields on PHY firmware header"
	default n
	depends on SOC_XWAY

endif
```

## kernel/drivers/net/ethernet/lantiq/Kconfig
```kconfig
config NET_VENDOR_LANTIQ
        bool "Lantiq network devices"
        default y
        depends on  SOC_XWAY
        ---help---
          If you have a network (Ethernet) card belonging to this class, say Y
          and read the Ethernet-HOWTO, available from
          <http://www.tldp.org/docs.html#howto>.

if NET_VENDOR_LANTIQ

config LANTIQ_VRX318
	tristate "VRX318 SmartPHY PCIe EP driver"
	depends on PCIE_LANTIQ
	default n
	---help---
	Supported VRX318 smartPHY PCIe EP

config LANITQ_VRX318_PCIE_SWITCH_DSL_BONDING
	tristate "VRX318 SmartPHY DSL bonding with PCIe Switch"
	depends on LANTIQ_VRX318
	default n
	---help---
	Supported VRX318 smartPHY PCIe DSL Bonding with PCIe switch

config LANTIQ_ETH_FRAMEWORK
	bool "Lantiq framework for ethernet drivers"
	depends on LANTIQ
	default n
	---help---
	Lantiq framework for ethernet drivers

config LTQ_ETH_OAM
  tristate "Ethernet OAM Handler"
  depends on LANTIQ
  ---help---
     This feature helps to create a eth oam virtual netdevice and handle the dot1agd control packets.

source "drivers/net/ethernet/lantiq/switch-api/Kconfig"

endif # NET_VENDOR_LANTIQ
```

## kernel/drivers/net/lantiq_ppa/Kconfig
```kconfig
config LTQ_PPA
	bool "PPA Acceleration Package"
	depends on LANTIQ && ETHERNET
	default n
	help
	  Acceleration Package Support

choice
   prompt "PPA Platform Selection"
   default LTQ_PPA_XRX330
   
   config LTQ_PPA_XRX100
      depends on LTQ_PPA
      bool "xRX100"

   config LTQ_PPA_XRX200
      depends on LTQ_PPA
      bool "xRX200"

   config LTQ_PPA_XRX300
      depends on LTQ_PPA
      bool "xRX300"
   
   config LTQ_PPA_XRX330
      depends on LTQ_PPA
      bool "xRX330"
endchoice

config LTQ_PPA_API
	tristate "PPA Acceleration Package - Kernel APIs"
	depends on LTQ_PPA && LTQ_PPA_DATAPATH
	default y
	help
	  PPA APIs and Kernel Hookup

config LTQ_MINI_JUMBO_FRAME_SUPPORT
	tristate "Mini Jumbo Frame support"
	depends on LTQ_PPA 
	default n
	help
	  Mini Jumbo Frame support


config LTQ_PPA_API_DIRECTPATH
	bool "Direct Path Support for PPA API"
	depends on LTQ_PPA_API
	default y
	help
	  Direct Path Support (e.g. WLAN) for PPA API

config LTQ_PPA_API_DIRECTPATH_BRIDGING
	bool "Bridging Support in Direct Path"
	depends on LTQ_PPA_API_DIRECTPATH
	default y
	help
	  Let PPA accelerate bridging traffic. (Not good performance in D4/A4)

config LTQ_PPA_HANDLE_CONNTRACK_SESSIONS
          bool "Handle Session Limit"
          depends on LTQ_PPA_API
          default n
          help
             Session limiting support based on session criteria ( priority and threshold )

choice
	prompt "Software TX Queue"
	depends on LTQ_PPA_API_DIRECTPATH
	default LTQ_PPA_DIRECTPATH_TX_QUEUE_NONE

config LTQ_PPA_DIRECTPATH_TX_QUEUE_NONE
	bool "No Support"
	help
	  Do not support Directpath Software TX Queue.

config LTQ_PPA_DIRECTPATH_TX_QUEUE_SIZE
	bool "Queue Length - 1524 x 50 bytes"
	help
	  TX queue length is counted in total bytes of all packets in queue.
	  It provides better performance while handling burst traffic, if the
	  size of packets is random. Default value is 1524 x 50 bytes and can
	  be changed with parameter "directpath_tx_queue_size" passed in kernel
	  command line or loadable module parameter.

config LTQ_PPA_DIRECTPATH_TX_QUEUE_PKTS
	bool "Queue Length - 50 packets"
	help
	  TX queue length is counted in number of packets in queue. It provides
	  less overhead with acceptable performance while handling burst
	  traffic. Default value is 50 packets and can be changed with parameter
	  "directpath_tx_queue_pkts" passed in kernel command line or loadable
	  module parameter.
config LTQ_PPA_DIRECTPATH_TX_IMQ
	bool "Use IMQ for Directpath Rateshaping"
	help
	  Use IMQ to do Directpath Rateshaping to solve burst issue
endchoice

config LTQ_PPA_API_DIRECTPATH_TASKLET
	bool "Directpath use tasklet on TX queue"
	depends on LTQ_PPA_API_DIRECTPATH && (LTQ_PPA_DIRECTPATH_TX_QUEUE_SIZE || LTQ_PPA_DIRECTPATH_TX_QUEUE_PKTS)
	help
        Directpath use tasklet to send frames from registered device.

config LTQ_PPA_API_PROC
	tristate "Proc Filesystem Support for PPA API"
	depends on LTQ_PPA_API
	default y
	help
	  Proc Filesystem Support for PPA API

config LTQ_PPA_MFE
        bool "Multiple Filed Classification and Vlan Editing"
        depends on LTQ_PPA_API
        default n
        help
          Multiple Field Classification and Vlan Editing feature PPA API

config LTQ_PPA_QOS
        bool "QOS"
        depends on LTQ_PPA_API
        default y
        help
          QOS support

config LTQ_PPA_QOS_WFQ
        bool "QOS WFQ"
        depends on LTQ_PPA_QOS
        default y
        help
          QOS WFQ support

config LTQ_PPA_QOS_RATE_SHAPING
        bool "QOS Rate Shaping"
        depends on LTQ_PPA_QOS
        default y
        help
          QOS Rate Shaping support

config LTQ_PPA_IPv6_ENABLE
	bool "PPA IPv6 support"
	depends on LTQ_PPA_API
	default y

config LTQ_PPA_DATAPATH
	tristate "PPA Acceleration Package - Data Path Driver"
	depends on LTQ_PPA
	default y
	select LTQ_ETH_FRAMEWORK
	help
	  PPA Low Level Driver (Data Path)

menu "Package Selection"
	depends on LTQ_PPA_DATAPATH

config LTQ_PPA_A5
	bool "PPA A5 Package <MII0/1 + ATM>"
   depends on LTQ_PPA_XRX100 || LTQ_PPA_XRX200 || LTQ_PPA_XRX300
	default n

config LTQ_PPA_D5
	bool "PPA D5 Package <MII0/1>"
   depends on LTQ_PPA_XRX100 || LTQ_PPA_XRX200 || LTQ_PPA_XRX300 || LTQ_PPA_XRX330
	default n

config LTQ_PPA_E5
	bool "PPA E5 Package <MII0/1 + PTM>"
   depends on LTQ_PPA_XRX100 || LTQ_PPA_XRX200 || LTQ_PPA_XRX300
	default n

config LTQ_PPE_E5_OFFCHIP_BONDING
	bool "PPA E5 Off-chip Bonding Support"
	depends on LTQ_PPA_XRX200
	select LTQ_PPA_E5
	default n

config LTQ_PPA_A1
	bool "VRX218 ATM Module"
#	depends on VRX318_PCIE_EP && (LTQ_PPA_XRX200 || LTQ_PPA_XRX300)
	depends on (LTQ_PPA_XRX300 || LTQ_PPA_XRX330)
	select LTQ_PPA_D5
	default n

config LTQ_PPA_E1
	bool "VRX218 PTM Module"
#	depends on VRX318_PCIE_EP && (LTQ_PPA_XRX200 || LTQ_PPA_XRX300)
	depends on (LTQ_PPA_XRX300 || LTQ_PPA_XRX330)
	select LTQ_PPA_D5
	default n

endmenu

config SUPPORT_PMAC_FLOWCONTROL
	bool "Enable PMAC flow control"
	depends on LTQ_PPA_XRX300 || LTQ_PPA_XRX200 || LTQ_PPA_XRX330
	default n

config GRX390_MM_ENHANCE
	bool "Use GRX390 Memory Enhance feature,(GRX390 Only)"
	depends on LTQ_PPA_XRX330
	default n

config ACCL_11AC
	bool "Support Acceleration Qualcomm 11ac"
	depends on GRX390_MM_ENHANCE
	default n

config VRX218_DSL_DFE_LOOPBACK
	bool "SmartPHY DSL DFE Loopback Mode (PPA Testing Only)"
	depends on LTQ_PPA_A1 || LTQ_PPA_E1
	default n

config DSL_DFE_LOOPBACK
	tristate "xRX300 DSL DFE Loopback Mode (PPA Testing Only)"
	depends on LTQ_PPA && LTQ_PPA_XRX300
	default n

config LOOP_ETH_DEV
	tristate "Loopback ETH Emulation Device(PPA Testing Only)"
	depends on LTQ_PPA
	default n

config LTQ_PORT_MIRROR
	bool "Port Mirror support (Debugging Feature)"
	depends on LTQ_PPA
	default y
	help
	  Port mirror support.

config PTM_VECTORING
	tristate "PTM Vectoring Error Report Support"
	default n

config LTQ_PPA_PORT_SEPARATION
	bool "Port Seperation support"
	default n
```

## package/feeds/ltq_common/lib-dti-ecos/config/Config.in
```kconfig
config COMMON_DLI_DEBUG_PRINTS
	bool
	prompt "Enable verbose debug output"
	default y

config COMMON_DLI_ERROR_PRINTS
	bool
	prompt "Enable error output"
	default y
```

## package/feeds/ltq_dsl_cpe/dsl-cpe-api-danube/Config.in
```kconfig
menu "Configuration"
	depends on PACKAGE_dsl-cpe-api-danube

	choice
		prompt "build model"
		default dsl-cpe-api-danube_MODEL_FOOTPRINT
		help
		  Selection of a model (predefined combination of configure options).

	config dsl-cpe-api-danube_MODEL_LITE
		bool "Lite"
		help
		  Minimum features included.
		  This model should ONLY demonstrate the minimum possible size.

	config dsl-cpe-api-danube_MODEL_FOOTPRINT
		bool "Footprint"
		help
		  Defined for low footprint applications.

	config dsl-cpe-api-danube_MODEL_TYPICAL
		bool "Typical"
		help
		  Defined for most typical use.

	config dsl-cpe-api-danube_MODEL_FULL
		bool "Full"
		help
		  Includes all features but NOT all debug functionalities.

	config dsl-cpe-api-danube_MODEL_DEBUG
		bool "Debug"
		help
		  Includes all features AND debug functionalities.
	endchoice

	menu "optional build options"
		depends on PACKAGE_dsl-cpe-api-danube
	config dsl-cpe-api-danube_USE_ADDITIONAL_BUILD_OPTIONS
		depends on PACKAGE_dsl-cpe-api-danube
		bool "Use additional build options"
		default n
		help
		  Provides the possibility to include/exclude single features directly.
		  This configuration overwrites selections which are done by the "build model" configuration.

	config dsl-cpe-api-danube_ADDITIONAL_BUILD_OPTIONS
		depends on dsl-cpe-api-danube_USE_ADDITIONAL_BUILD_OPTIONS
		string "Additional build options"
		help
		  Defines to include/exclude single feature using available configure options.
		  Please refer to the documentation of the DSL CPE API "Configure options for the DSL CPE API"
	endmenu
endmenu
```

## package/feeds/ltq_dsl_cpe/dsl-cpe-control-danube/Config.in
```kconfig
menu "Configuration"
	depends on PACKAGE_dsl-cpe-control-danube

	config dsl-cpe-control-danube_DTI
		bool "Include DTI"
		select PACKAGE_lib-dti
		default n
		help
		  Defines to include/exclude the Debug & Trace Interface.

	choice
		prompt "build model"
		default dsl-cpe-control-danube_MODEL_FOOTPRINT
		help
		  Selection of a model (predefined combination of configure options).

	config dsl-cpe-control-danube_MODEL_LITE
		bool "Lite"
		help
		  Minimum features included.
		  This model should ONLY demonstrate the minimum possible size.

	config dsl-cpe-control-danube_MODEL_FOOTPRINT
		bool "Footprint"
		select dsl-cpe-control-danube_DTI
		help
		  Defined for low footprint applications.

	config dsl-cpe-control-danube_MODEL_TYPICAL
		bool "Typical"
		select dsl-cpe-control-danube_DTI
		help
		  Defined for most typical use.

	config dsl-cpe-control-danube_MODEL_FULL
		bool "Full"
		select dsl-cpe-control-danube_DTI
		help
		  Includes all features but NOT all debug functionalities.

	config dsl-cpe-control-danube_MODEL_DEBUG
		bool "Debug"
		select dsl-cpe-control-danube_DTI
		help
		  Includes all features AND debug functionalities.
	endchoice

	menu "optional build options"
		depends on PACKAGE_dsl-cpe-control-danube
	config dsl-cpe-control-danube_USE_ADDITIONAL_BUILD_OPTIONS
		bool "Use additional build options"
		default n
		help
		  Provides the possibility to include/exclude single features directly.
		  This configuration overwrites selections which are done by the "build model" configuration.

	config dsl-cpe-control-danube_ADDITIONAL_BUILD_OPTIONS
		depends on dsl-cpe-control-danube_USE_ADDITIONAL_BUILD_OPTIONS
		string "Additional build options"
		help
		  Defines to include/exclude single feature using available configure options.
		  Please refer to the documentation of the DSL CPE API "Configure options for the DSL CPE API"

	endmenu
endmenu
```

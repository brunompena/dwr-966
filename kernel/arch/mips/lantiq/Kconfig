## package/feeds/ltq_voice_cpe/ltq-voice-vmmc/config/Config.in
```kconfig
menu "advanced configuration (for developers)"
	depends on PACKAGE_ltq-voice-vmmc

config LTQ_VOICE_VMMC_USER_FLAGS
	depends on PACKAGE_ltq-voice-vmmc
	string "Additional CFLAGS"
	default ""
        help
                Additional CFLAGS for compilation (for developers)

config LTQ_VOICE_VMMC_USER_OPTIONS
	depends on PACKAGE_ltq-voice-vmmc
	string "Additional autogen configure options"
        default ""
        help
                Additional autogen configure options (for developers)

config LTQ_VOICE_VMMC_MPS_HISTORY_SIZE
	depends on PACKAGE_ltq-voice-vmmc
	string "MPS history buffer in words (0<=size<=512)"
	default "128"
	help
		MPS history buffer (default=128 words, maximum=512 words, 0=disable)
		To opimize the memory footprint in RAM, you might want to set the
		buffer size to 0.
endmenu

choice
	depends on PACKAGE_ltq-voice-vmmc
	prompt "device selection"
	default LTQ_VOICE_VMMC_WITH_DEVICE_XRX100 if (                                                TARGET_ltqcpe_ar9  || TARGET_ltqcpe_platform_ar9 || TARGET_ifxcpe_platform_ar9)
	default LTQ_VOICE_VMMC_WITH_DEVICE_XRX200 if (TARGET_lantiq_xrx200 ||                         TARGET_ltqcpe_vr9  || TARGET_ltqcpe_platform_vr9 || TARGET_ifxcpe_platform_vr9)
	default LTQ_VOICE_VMMC_WITH_DEVICE_XRX300 if (TARGET_lantiq_xrx300 || TARGET_lantiq_xrx330 || TARGET_ltqcpe_ar10 || TARGET_ltqcpe_platform_ar10)
	help
		Select the target device.

	config LTQ_VOICE_VMMC_WITH_DEVICE_XRX100
		bool "xRX100 family"
		select PACKAGE_ltq-voice-vmmc-xrx100-firmware
		select PACKAGE_ltq-voice-vmmc-xrx100-coef

	config LTQ_VOICE_VMMC_WITH_DEVICE_XRX200
		bool "xRX200 family"
		select PACKAGE_ltq-voice-vmmc-xrx200-firmware
		select PACKAGE_ltq-voice-vmmc-xrx200-coef

	config LTQ_VOICE_VMMC_WITH_DEVICE_XRX300
		bool "xRX300 family"
		select PACKAGE_ltq-voice-vmmc-xrx300-firmware
		select PACKAGE_ltq-voice-vmmc-xrx300-coef
endchoice

config LTQ_VOICE_VMMC_PMU
	depends on PACKAGE_ltq-voice-vmmc
	bool "Power Management Unit support"
	default y
	help
		Option to use Power Management Unit functionality.

config LTQ_VOICE_VMMC_DISABLE_DECT_NIBBLE_SWAP
	depends on PACKAGE_ltq-voice-vmmc
	bool "disable DECT nibble swap"
	default n
	help
		Option to disable DECT nibble swap for COSIC modem.
		This is only needed for backward compatibility.

config LTQ_VOICE_VMMC_SSLIC_FXO_ACTIVATE
	depends on PACKAGE_ltq-voice-vmmc
	bool "Activate SmartSLIC FXO ports upon TAPI init"
	default n
	help
		Option to activate FXO ports connected to a SmartSLIC by default.
                This should be disabled unless there is an FXO chip connected to
                the GPIOs of the SmartSLIC. Otherwise the SmartSLIC may consume
                quite some processor power depending on the signals on the GPIO pins
                of the SmartSLIC.
                Do not set for the LANTIQ xRX100 or xRX200 Family boards.

config LTQ_VOICE_VMMC_RTCP_XR
	depends on PACKAGE_ltq-voice-vmmc
	bool "RTCP Extended Reports support"
	default y
	help
		Option to enable support for the RTCP Extended Reports (RFC3611) functionality.
```

## package/feeds/ltq_voice_cpe/ltq-voice-wineasy/config/Config.in
```kconfig
menu "advanced configuration (for developers)"
	depends on PACKAGE_ltq-voice-wineasy

config LTQ_VOICE_WINEASY_USER_FLAGS
        depends on PACKAGE_ltq-voice-wineasy
        string "Additional CFLAGS"
        default ""
        help
                Additional CFLAGS for compilation (for developers)

config LTQ_VOICE_WINEASY_USER_OPTIONS
        depends on PACKAGE_ltq-voice-wineasy
        string "Additional autogen configure options"
        default ""
        help
                Additional autogen configure options (for developers)

config  LTQ_VOICE_WINEASY_IFXOS_SUPPORT
	bool "enable IFXOS library support"
	depends on PACKAGE_ltq-voice-wineasy
	default n
	help
		Option to enable IFXOS library usage
endmenu

choice
   prompt "board selection"
   depends on PACKAGE_ltq-voice-wineasy
   default LTQ_VOICE_WINEASY_BOARD_EASY508xx     if (                                                TARGET_ltqcpe_ar9  || TARGET_ltqcpe_platform_ar9 || TARGET_ifxcpe_platform_ar9)
   default LTQ_VOICE_WINEASY_BOARD_EASY80910     if (TARGET_lantiq_xrx200 ||                         TARGET_ltqcpe_vr9  || TARGET_ltqcpe_platform_vr9 || TARGET_ifxcpe_platform_vr9)
   default LTQ_VOICE_WINEASY_BOARD_XWAY_XRX300   if (TARGET_lantiq_xrx300 || TARGET_lantiq_xrx330 || TARGET_ltqcpe_ar10 || TARGET_ltqcpe_platform_ar10)
   default LTQ_VOICE_WINEASY_BOARD_EASY80910
   help
      Select the board the image will run on.

   config LTQ_VOICE_WINEASY_BOARD_EASY508xx
      bool "EASY508xx XWAY(TM) XRX100 Family Board"

   config LTQ_VOICE_WINEASY_BOARD_EASY80910
      bool "EASY809xx XWAY(TM) XRX200 Family Board"

   config LTQ_VOICE_WINEASY_BOARD_XWAY_XRX300
      bool "EASY3xx XWAY(TM) XRX300 Family Board / EASY389 BOND Reference Board"

endchoice

config  LTQ_VOICE_WINEASY_DXT_EXT
	bool "enable DUSLIC-xT extension board support"
	depends on PACKAGE_ltq-voice-wineasy
	depends on PACKAGE_ltq-voice-duslic_xt
	default y
	help
		enable DUSLIC-xT extension board support
```

## package/wnc-packages/gct-driver/src/Kconfig
```kconfig
# GCT GDM724x LTE driver configuration
#

menuconfig LTE_GDM724X
	tristate "GCT GDM724x LTE support"
	depends on NET
	help
	  Support for the GCT GDM724x LTE chip

if LTE_GDM724X

choice
	prompt "Select interface"
	
config LTE_GDM724X_USB
	bool "USB"
	depends on USB

config LTE_GDM724X_SDIO
	bool "SDIO"
	depends on MMC

endchoice

if LTE_GDM724X_SDIO

config LTE_GDM724X_SDIO_BOOT
	bool "Enable SDIO boot"
	default y

config LTE_GDM724X_SDIO_AT_COMMAND_EXTENDED
	bool "Enable SDIO at command extended"
	default y

config LTE_GDM724X_SDIO_DEVICE_STATUS_CHECK
	bool "Enable SDIO status check"
	default n

config LTE_GDM724X_SDIO_MODEM_PORT
	bool "Enable SDIO modem port"
	default y

endif # LTE_GDM724X_SDIO


config LTE_GDM724X_TX_DELAY
	bool "Enable TX DELAY"
	default n

config LTE_GDM724X_NV_HOST
	bool "Enable NV from Host"
	default n

config LTE_GDM724X_RX_FLOW_CONTROL
	bool "Enable RX Flow Control"
	default n

endif # LTE_GDM724X
```

## target/linux/lantiq/files/drivers/net/ethernet/lantiq/switch-api/Kconfig
```kconfig
#
# switch api configuration
#
config LTQ_ETHSW_API
    tristate "Lantiq Ethernet Switch API"
    default y
    help
    Support for Lantiq Ethernet Switch API.

menu LQ_ETHSW_API_OPTIONS
 
config LTQ_8021X
	depends on (LTQ_ETHSW_API && (SOC_TYPE_XWAY))
	default y
	bool "Support LTQ ETHSW 802.1X Switch API's"
    help
    Supported Lantiq Switch API for 802.1X features.

config LTQ_MULTICAST
	depends on (LTQ_ETHSW_API && (SOC_TYPE_XWAY))
	default y
	bool "Support LTQ ETHSW MULTICAST Switch API's"
    help
    Supported Lantiq Switch API for multicast features.
    
config LTQ_QOS
	depends on (LTQ_ETHSW_API && (SOC_TYPE_XWAY))
	default y
	bool "Support LTQ ETHSW QOS Switch API's"
    help
    Supported Lantiq Switch API for  Quality of Service (QoS) features.
    
config LTQ_STP
	depends on (LTQ_ETHSW_API && (SOC_TYPE_XWAY))
	default y
	bool "Support LTQ ETHSW STP Switch API's"
    help
    Supported Lantiq Switch API for Spanning  Tree  Protocol(STP) features.
    
config LTQ_VLAN
	depends on (LTQ_ETHSW_API && (SOC_TYPE_XWAY))
	default y
	bool "Support LTQ ETHSW VLAN Switch API's"
    help
    Supported Lantiq Switch API for VLAN features.

config LTQ_WOL
	depends on (LTQ_ETHSW_API && (SOC_TYPE_XWAY))
	default y
	bool "Support LTQ ETHSW WOL Switch API's"
    help
    Supported Lantiq Switch API for Wake-On-Lan(WOL) features.
endmenu

config LTQ_ETHSW_API_COC 
    bool "Switch API CoC support"
    depends on (LTQ_ETHSW_API && (SOC_TYPE_XWAY))
    default n
    help
    Supported Lantiq Platform

config LTQ_ETHSW_API_COC_PMCU
    bool "Switch API CoC PMCU module support"
    depends on (LTQ_ETHSW_API && (IFX_PMCU || CPU_FREQ) && (SOC_TYPE_XWAY ))
    default n
    help
    Supported Lantiq Platform
```

## package/feeds/ltq_dsl_cpe/dsl-cpe-mei-danube/Config.in
```kconfig
menu "Configuration"
	depends on PACKAGE_dsl-cpe-mei-danube

	choice
		prompt "build model"
		default dsl-cpe-mei-danube_MODEL_DEFAULT
		help
		  Selection of a model (predefined combination of configure options).

	config dsl-cpe-mei-danube_MODEL_DEFAULT
		bool "Default"
		help
		  Default features included, no debug support.

	config dsl-cpe-mei-danube_MODEL_DEBUG
		bool "Debug"
		help
		  Defined to enable debug support within the driver.
	endchoice

	menu "debug options"
		depends on dsl-cpe-mei-danube_MODEL_DEBUG
	config dsl-cpe-mei-danube_DBG_BAR_MEMORY_CHECK
		depends on dsl-cpe-mei-danube_MODEL_DEBUG
		bool "Include CRC check of BAR register memory blocks"
		default n
		help
		  Defines to enable/disable the debug handling that periodically checks the CRC of the
		  BAR memory blocks (64k) that has been allocated for storing the DSL Firmware binary.
		  Initial CRC's will be calculated and printed to the console. Periodical checks will
		  only print something to the console in case of a changed CRC.
	endmenu

	config dsl-cpe-mei-danube_USE_KERNEL_BUILD_IN
		bool "use kernel build-in"
		default n

	menu "optional build options"
		depends on PACKAGE_dsl-cpe-mei-danube
	config dsl-cpe-mei-danube_USE_ADDITIONAL_BUILD_OPTIONS
		depends on PACKAGE_dsl-cpe-mei-danube
		bool "Use additional build options"
		default n
		help
		  Provides the possibility to include/exclude single features directly.
		  This configuration overwrites selections which are done by the "build model" configuration.

	config dsl-cpe-mei-danube_ADDITIONAL_BUILD_OPTIONS
		depends on dsl-cpe-mei-danube_USE_ADDITIONAL_BUILD_OPTIONS
		string "Additional build options"
		help
		  Defines to include/exclude single feature using available configure options.
	endmenu
endmenu
```

## package/feeds/ltq_feeds_coc/lq-coc-app-pm/config/Config.in
```kconfig
menu "Configuration"
	depends on PACKAGE_lq-coc-app-pm

	config FEATURE_LQ_COC_APP_PM_SUPPORT_DTI
		bool "PMCU Utility with dti support"
		default n
		help
		  pmcu_utiliy_dti binary will be generated.
endmenu
```

## package/feeds/ltq_feeds_wave/lq-wave-300/config/Config.in
```kconfig
config FEATURE_LTQ_WAVE_300
	depends on PACKAGE_ltq-wlan-wave
	bool 'Enable WAVE300 support'
	help
	  Support for WAVE300

config FEATURE_LTQ_WAVE_400
	depends on PACKAGE_ltq-wlan-wave
	bool 'Enable WAVE400 support'
	help
	  Support for WAVE400

config FEATURE_LTQ_WAVE_AR10_SUPPORT
	depends on PACKAGE_ltq-wlan-wave
	bool 'Enable WAVE support for AR10'
	help
	  Support for WAVE on AR10 platforms

config FEATURE_LTQ_WAVE_STA
	bool 'Enable WAVE station support'
	help
	  Support for WAVE STA mode
```

## package/feeds/ltq_voice_cpe/ltq-voice-tapi-lib-country/config/Config.in
```kconfig
menu "advanced configuration (for developers)"
	depends on PACKAGE_ltq-voice-tapi-lib-country

config VOICE_TAPI_LIB_COUNTRY_USER_FLAGS
	depends on PACKAGE_ltq-voice-tapi-lib-country
        string "Additional CFLAGS"
        default ""
        help
                Additional CFLAGS for compilation (for developers)

config VOICE_TAPI_LIB_COUNTRY_USER_OPTIONS
	depends on PACKAGE_ltq-voice-tapi-lib-country
        string "Additional autogen configure options"
        default ""
        help
                Additional autogen configure options (for developers)
endmenu

menu "select countries"
	depends on PACKAGE_ltq-voice-tapi-lib-country

config  VOICE_TAPI_LIB_COUNTRY_AU
	bool "Australia"
	depends on PACKAGE_ltq-voice-tapi-lib-country
	default y
	help
		Australia

config  VOICE_TAPI_LIB_COUNTRY_AT
	bool "Austria"
	depends on PACKAGE_ltq-voice-tapi-lib-country
	default y
	help
		Austria

config  VOICE_TAPI_LIB_COUNTRY_BE
	bool "Belgium"
	depends on PACKAGE_ltq-voice-tapi-lib-country
	default y
	help
		Belgium

config  VOICE_TAPI_LIB_COUNTRY_DK
	bool "Denmark"
	depends on PACKAGE_ltq-voice-tapi-lib-country
	default y
	help
		Denmark

config  VOICE_TAPI_LIB_COUNTRY_FR
	bool "France"
	depends on PACKAGE_ltq-voice-tapi-lib-country
	default y
	help
		France

config  VOICE_TAPI_LIB_COUNTRY_DE
	bool "Germany"
	depends on PACKAGE_ltq-voice-tapi-lib-country
	default y
	help
		Germany

config  VOICE_TAPI_LIB_COUNTRY_IT
	bool "Italy"
	depends on PACKAGE_ltq-voice-tapi-lib-country
	default y
	help
		Italy

config  VOICE_TAPI_LIB_COUNTRY_NL
	bool "Netherlands"
	depends on PACKAGE_ltq-voice-tapi-lib-country
	default y
	help
		Netherlands

config  VOICE_TAPI_LIB_COUNTRY_NO
	bool "Norway"
	depends on PACKAGE_ltq-voice-tapi-lib-country
	default y
	help
		Norway

config  VOICE_TAPI_LIB_COUNTRY_PL
	bool "Poland"
	depends on PACKAGE_ltq-voice-tapi-lib-country
	default y
	help
		Poland

config  VOICE_TAPI_LIB_COUNTRY_ES
	bool "Spain"
	depends on PACKAGE_ltq-voice-tapi-lib-country
	default y
	help
		Spain

config  VOICE_TAPI_LIB_COUNTRY_SE
	bool "Sweden"
	depends on PACKAGE_ltq-voice-tapi-lib-country
	default y
	help
		Sweden

config  VOICE_TAPI_LIB_COUNTRY_CH
	bool "Switzerland"
	depends on PACKAGE_ltq-voice-tapi-lib-country
	default y
	help
		Switzerland

config  VOICE_TAPI_LIB_COUNTRY_GB
	bool "United Kingdom"
	depends on PACKAGE_ltq-voice-tapi-lib-country
	default y
	help
		United Kingdom

config  VOICE_TAPI_LIB_COUNTRY_AE
	bool "United Arabs Emirates"
	depends on PACKAGE_ltq-voice-tapi-lib-country
	default y
	help
		United Arabs Emirates

config  VOICE_TAPI_LIB_COUNTRY_US
	bool "United States of America"
	depends on PACKAGE_ltq-voice-tapi-lib-country
	default y
	help
		United States of America
endmenu
```

## package/feeds/ltq_voice_cpe/ltq-voice-tapi-lib-nlt/config/Config.in
```kconfig
menu "advanced configuration (for developers)"
        depends on PACKAGE_ltq-voice-lib-nlt

config LTQ_VOICE_LIB_NLT_USER_FLAGS
        depends on PACKAGE_ltq-voice-lib-nlt
        string "Additional CFLAGS"
        default ""
        help
                Additional CFLAGS for compilation (for developers)

config LTQ_VOICE_LIB_NLT_USER_OPTIONS
        depends on PACKAGE_ltq-voice-lib-nlt
        string "Additional autogen configure options"
        default ""
        help
                Additional autogen configure options (for developers)

config  LTQ_VOICE_LIB_NLT_IFXOS_SUPPORT
	bool "enable IFXOS library support"
	depends on PACKAGE_ltq-voice-lib-nlt
	default n
	help
		Option to enable IFXOS library usage

endmenu

config  LTQ_VOICE_LIB_NLT_VMMC
	bool "enable support for VMMC device"
	depends on PACKAGE_ltq-voice-lib-nlt
		default y if PACKAGE_ltq-voice-vmmc
	default y if PACKAGE_ltq-voice-vmmc
	default n
	help
		Option to enable Line Testing support for VMMC family devices

config  LTQ_VOICE_LIB_NLT_DXT
	bool "enable support for DXT device"
	depends on PACKAGE_ltq-voice-lib-nlt
	default y if PACKAGE_ltq-voice-duslic_xt
	default n
	help
		Option to enable Line Testing support for DUSLIC-xT device
```

## package/feeds/ltq_voice_cpe/ltq-voice-tapidemo/config/Config.in
```kconfig
menu "advanced configuration (for developers)"
   depends on PACKAGE_ltq-voice-tapidemo

config LTQ_VOICE_TAPIDEMO_USER_FLAGS
        depends on PACKAGE_ltq-voice-tapidemo
        string "Additional CFLAGS"
        default ""
        help
                Additional CFLAGS for compilation (for developers)

config LTQ_VOICE_TAPIDEMO_USER_OPTIONS
        depends on PACKAGE_ltq-voice-tapidemo
        string "Additional autogen configure options"
        default ""
        help
                Additional autogen configure options (for developers)
endmenu

choice
   prompt "board selection"
   depends on PACKAGE_ltq-voice-tapidemo
   default LTQ_VOICE_TAPIDEMO_BOARD_EASY508xx     if (                                                TARGET_ltqcpe_ar9  || TARGET_ltqcpe_platform_ar9 || TARGET_ifxcpe_platform_ar9)
   default LTQ_VOICE_TAPIDEMO_BOARD_EASY80910     if (TARGET_lantiq_xrx200 ||                         TARGET_ltqcpe_vr9  || TARGET_ltqcpe_platform_vr9 || TARGET_ifxcpe_platform_vr9)
   default LTQ_VOICE_TAPIDEMO_BOARD_XWAY_XRX300   if (TARGET_lantiq_xrx300 || TARGET_lantiq_xrx330 || TARGET_ltqcpe_ar10 || TARGET_ltqcpe_platform_ar10)
   default LTQ_VOICE_TAPIDEMO_BOARD_EASY80910
   help
      Select the target platform.

   config LTQ_VOICE_TAPIDEMO_BOARD_EASY508xx
      bool "XWAY(TM) XRX100 Reference Board"

   config LTQ_VOICE_TAPIDEMO_BOARD_EASY80910
      bool "XWAY(TM) XRX200 Reference Board"

   config LTQ_VOICE_TAPIDEMO_BOARD_XWAY_XRX300
      bool "XWAY(TM) XRX300 Family Board / EASY389 BOND Reference Board"
endchoice

config LTQ_VOICE_TAPIDEMO_QOS
	bool "enable QOS support"
	depends on PACKAGE_ltq-voice-tapidemo
	default y
	help
		Option to enable the KPI2UDP RTP packet acceleration path
		(highly recommended for VoIP).

config  LTQ_VOICE_TAPIDEMO_FAX_MODEM
	bool "enable fax/modem transparent support"
	depends on PACKAGE_ltq-voice-tapidemo
	default y if LTQ_VOICE_TAPIDEMO_FAX_T_38_FW
	default n
	help
		Enable fax/modem transparent support.

config  LTQ_VOICE_TAPIDEMO_FAX_T_38_FW
	bool "enable T.38 fax relay"
	depends on PACKAGE_ltq-voice-tapidemo
	default y
	help
		Enable T.38 fax relay demo,
		when enabled then fax/modem transparent support is also enabled.

config  LTQ_VOICE_TAPIDEMO_DXT_EXT
	bool "enable DUSLIC-xT extension board support"
	depends on PACKAGE_ltq-voice-tapidemo
	depends on PACKAGE_ltq-voice-duslic_xt
	default y
	help
		enable DUSLIC-xT extension board support

config  LTQ_VOICE_TAPIDEMO_DECT
	bool "enable DECT support"
	depends on PACKAGE_ltq-voice-tapidemo
	depends on PACKAGE_ifx-dect
	default y
	help
		enable DECT support.

config LTQ_VOICE_TAPIDEMO_COUNTRY_LIBRARY
	bool "TAPI Country library support"
	depends on PACKAGE_ltq-voice-tapidemo
	select PACKAGE_ltq-voice-tapi-lib-country
	default n
	help
		Option to build country library support into tapidemo.

config LTQ_VOICE_TAPIDEMO_EVENT_LOGGER
	depends on PACKAGE_ltq-voice-tapidemo
	depends on +PACKAGE_ltq-evtlog
	bool "event logger support"
	default y
	help
		Option to send traces from Tapidemo to Event Logger
		- for debugging only
		- requires package ltq-evtlog
```

## package/feeds/ltq_voice_cpe/ltq-voice-vmmc-xrx100-coef/config/Config.in
```kconfig
choice
   depends on PACKAGE_ltq-voice-vmmc-xrx100-coef
   prompt "FXS coefficients"
   default LTQ_VOICE_VMMC_XRX100_COEF_ETSI
   help
      Select country specific FXS coefficient file.

   config LTQ_VOICE_VMMC_XRX100_COEF_ETSI
      bool "ETSI_T3R10: Vl:40V, Ic:25mA, Vid:25V, Vri:45Vrms, f:25Hz"
      help
        These coefficents contains a parameter set with line impedance Zr according to ETSI.

        T:   gain in transmit direction (attenuation 3dBr) [dBr]
        R:   gain in receive direction (attenuation 10dBr) [dBr]
        Vl:  on-hook voltage limit [V]
        Ic:  off-hook loop current [mA]
        Vid: low-power-standby voltage [V]
        Vri: ring voltage [v]
        f:   ring frequency [V]

   config LTQ_VOICE_VMMC_XRX100_COEF_US600R
      bool "USA_600R_T3R10: Vl:40V, Ic:25mA, Vid:25V, Vri:45V, f:20Hz"
      help
        These coefficents contains a parameter set with line impedance e.g. for USA.

        T:   gain in transmit direction (attenuation 3dBr) [dBr]
        R:   gain in receive direction (attenuation 10dBr) [dBr]
        Vl:  on-hook voltage limit [V]
        Ic:  off-hook loop current [mA]
        Vid: low-power-standby voltage [V]
        Vri: ring voltage [v]
        f:   ring frequency [V]

   config LTQ_VOICE_VMMC_XRX100_COEF_GERMANY
      bool "GERM_T3R10: Vl:40V, Ic:25mA, Vid:25V, Vri:45Vrms, f:25Hz"
      help
        These coefficents contains a parameter set with line impedance for Germany.

        T:   gain in transmit direction (attenuation 3dBr) [dBr]
        R:   gain in receive direction (attenuation 10dBr) [dBr]
        Vl:  on-hook voltage limit [V]
        Ic:  off-hook loop current [mA]
        Vid: low-power-standby voltage [V]
        Vri: ring voltage [v]
        f:   ring frequency [V]

   config LTQ_VOICE_VMMC_XRX100_COEF_USE_CUSTOM_FILE
      bool "Select own FXS coefficient file"
endchoice

menu "FXS own coefficient file"
    depends on PACKAGE_ltq-voice-vmmc-xrx100-coef
    depends on LTQ_VOICE_VMMC_XRX100_COEF_USE_CUSTOM_FILE
    config LTQ_VOICE_VMMC_XRX100_COEF_CUSTOM_FILE
    string "FXS own coefficient file"
endmenu

choice
   depends on PACKAGE_ltq-voice-vmmc-xrx100-coef
   prompt "FXO coefficients"
   default LTQ_VOICE_VMMC_XRX100_COEF_ETSI_FXO
   help
      Select country specific FXO coefficient file.

   config LTQ_VOICE_VMMC_XRX100_COEF_ETSI_FXO
      bool "ETSI: Tx:0dBr, Rx:0dBr"
      help
        These coefficents contains a parameter set with line impedance Zr according to ETSI.

        Tx:   gain in transmit direction (attenuation 0dBr) [dBr]
        Rx:   gain in receive direction (attenuation 0dBr) [dBr]

   config LTQ_VOICE_VMMC_XRX100_COEF_US600R_FXO
      bool "USA_600R: Tx:0dBr, Rx:0dBr"
      help
        These coefficents contains a parameter set with line impedance e.g. for USA.

        Tx:   gain in transmit direction (attenuation 0dBr) [dBr]
        Rx:   gain in receive direction (attenuation 0dBr) [dBr]

   config LTQ_VOICE_VMMC_XRX100_COEF_GERMANY_FXO
      bool "GERM: Tx:0dBr, Rx:0dBr"
      help
        These coefficents contains a parameter set with line impedance for Germany.

        Tx:   gain in transmit direction (attenuation 0dBr) [dBr]
        Rx:   gain in receive direction (attenuation 0dBr) [dBr]

   config LTQ_VOICE_VMMC_XRX100_COEF_USE_CUSTOM_FILE_FXO
      bool "Select own FXO coefficient file"
endchoice

menu "FXO own coefficient file"
   depends on PACKAGE_ltq-voice-vmmc-xrx100-coef
   depends on LTQ_VOICE_VMMC_XRX100_COEF_USE_CUSTOM_FILE_FXO
   config LTQ_VOICE_VMMC_XRX100_COEF_CUSTOM_FILE_FXO
   string "FXO own coefficient file"
endmenu
```
